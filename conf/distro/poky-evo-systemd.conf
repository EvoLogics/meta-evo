## conf/distro/poky-evo-systemd.conf
```bitbake
require conf/distro/poky.conf
IMAGE_VERSION = "7"

DISTRO = "poky-evo-systemd"
DISTRO_NAME = "Poky EvoLogics"
MAINTAINER = "Llewellyn Fernandes <llewellyn.fernandes@evologics.de>"
DISTROOVERRIDES = "poky:poky-evo-systemd"

#PACKAGE_CLASSES = "package_ipk"

TCLIBC = "glibc"

SDK_VERSION = "${DISTRO_VERSION}-${IMAGE_VERSION}"
SDK_NAME = "${DISTRO}-${TCLIBC}-${SDK_ARCH}-${IMAGE_BASENAME}-${TUNE_PKGARCH}"
SDKPATH = "/opt/${DISTRO}/${SDK_VERSION}"
SDKEXTPATH = "${SDKPATH}"

DISTRO_FEED_URI ?= "http://repos.evologics.de:8080/ipk"

SDKIMAGE_FEATURES_append = " package-management"

# We can use packagegroup-core-boot, but in the future we may need a new packagegroup-core-tiny
#POKY_DEFAULT_EXTRA_RDEPENDS += "packagegroup-core-boot"
# Drop kernel-module-af-packet from RRECOMMENDS
POKY_DEFAULT_EXTRA_RRECOMMENDS = ""


# Drop native language support. This removes the
# eglibc->bash->gettext->libc-posix-clang-wchar dependency.
USE_NLS="no"

VIRTUAL-RUNTIME_dev_manager = "udev"
VIRTUAL-RUNTIME_init_manager = "systemd"
DISTRO_FEATURES_BACKFILL_CONSIDERED += "sysvinit"
VIRTUAL-RUNTIME_login_manager = "busybox"
VIRTUAL-RUNTIME_syslog = ""
VIRTUAL-RUNTIME_initscripts = ""

# Comment out any of the lines below to disable them in the build
# DISTRO_FEATURES options:
DISTRO_FEATURES_SYSTEMD = "systemd"
DISTRO_FEATURES_TINY = "pci"
DISTRO_FEATURES_NET = "ipv4"
DISTRO_FEATURES_USB = "usbhost"
DISTRO_FEATURES_USBGADGET = "usbgadget"
DISTRO_FEATURES_WIFI = "wifi"

DISTRO_FEATURES_DEFAULT_remove = "argp irda pcmcia zeroconf x11 ipv6"
DISTRO_FEATURES = "${DISTRO_FEATURES_DEFAULT} systemd ${DISTRO_FEATURES_TINY} ${DISTRO_FEATURES_NET} ${DISTRO_FEATURES_USB} ${DISTRO_FEATURES_WIFI}"

DISTRO_FEATURES_class-native = "${DISTRO_FEATURES_DEFAULT} ${DISTRO_FEATURES_LIBC} ${POKY_DEFAULT_DISTRO_FEATURES}"
DISTRO_FEATURES_class-nativesdk = "${DISTRO_FEATURES_DEFAULT} ${DISTRO_FEATURES_LIBC} ${POKY_DEFAULT_DISTRO_FEATURES}"
```

## conf/layer.conf
```bitbake
# We have a conf and classes directory, append to BBPATH
BBPATH .= ":${LAYERDIR}"

# We have a recipes directory, add to BBFILES
BBFILES += "${LAYERDIR}/recipes*/*/*.bb \
            ${LAYERDIR}/recipes*/*/*.bbappend"

BBFILE_COLLECTIONS += "meta-evo"
BBFILE_PATTERN_meta-evo := "^${LAYERDIR}/"

# Define the priority for recipes (.bb files) from this layer,
# choosing carefully how this layer interacts with all of the
# other layers. 
# 
# openembedded-layer is 6, we want to be above that.

BBFILE_PRIORITY_meta-evo = "10"
```

## conf/machine/colibri-imx6-iris-evo.conf
```bitbake
#@TYPE: Machine
#@NAME: Toradex Colibri iMX6DL/S
#@SOC: i.MX6DL
#@DESCRIPTION: Machine configuration for Toradex Colibri iMX6 SOM
#@MAINTAINER: Max Krummenacher <max.krummenacher@toradex.com>

MACHINEOVERRIDES =. "mx6:mx6dl:mx6-evobb:"

include conf/machine/include/imx-base.inc
include conf/machine/include/tune-cortexa9.inc

PREFERRED_PROVIDER_virtual/kernel ??= "linux-toradex"
PREFERRED_PROVIDER_virtual/kernel_use-mainline-bsp ??= "linux-fslc"
KERNEL_DEVICETREE += " \
  imx6dl-colibri-eval-v3.dtb \
  imx6dl-colibri-cam-eval-v3.dtb \
  imx6dl-colibri-aster.dtb \
  imx6dl-colibri-eval-v3-sd18.dtb \
  imx6dl-colibri-iris-v2.dtb \
  "

KERNEL_DEVICETREE_use-mainline-bsp += "imx6dl-colibri-eval-v3.dtb"
KERNEL_IMAGETYPE = "uImage"
# The kernel lives in a seperate FAT partition, don't deploy it in /boot/
#RDEPENDS_${KERNEL_PACKAGE_NAME}-base = ""

PREFERRED_PROVIDER_u-boot ?= "u-boot-toradex"
PREFERRED_PROVIDER_virtual/bootloader ?= "u-boot-toradex"
PREFERRED_PROVIDER_u-boot-fw-utils ?= "u-boot-toradex-fw-utils"
PREFERRED_RPROVIDER_u-boot-fw-utils ?= "u-boot-toradex-fw-utils"

PREFERRED_VERSION_u-boot-toradex ?= "2016.11%"

SPL_BINARY = "SPL"
UBOOT_CONFIG ??= "spl"
UBOOT_CONFIG[spl] = "colibri_imx6_defconfig,,u-boot.img"
UBOOT_MAKE_TARGET = ""
UBOOT_ENTRYPOINT_use-mainline-bsp = "0x10008000"

IMAGE_FSTYPES += "ext4 wic"
# wic support
WKS_FILE = "${MACHINE}.wks"

MACHINE_FEATURES += "usbgadget usbhost vfat ext2"
```

## conf/machine/include/tx6-karo-common.inc
```bitbake
# Provides the Ka-Ro TX6 common settings

require conf/machine/include/imx-base.inc
require conf/machine/include/arm/armv7a/tune-cortexa9.inc

SERIAL_CONSOLE = "115200 ttymxc0"

UBOOT_SUFFIX = "bin"
UBOOT_MAKE_TARGET = "u-boot.bin"
UBOOT_BINARY="u-boot.bin"

PREFERRED_PROVIDER_u-boot ?= "u-boot-karo"
PREFERRED_PROVIDER_u-boot-fw-utils ?= "u-boot-karo-fw-utils"
PREFERRED_PROVIDER_u-boot-mfgtool ?= "u-boot-karo-mfgtool"
PREFERRED_PROVIDER_virtual/bootloader ?= "u-boot-karo"

PREFERRED_PROVIDER_virtual/kernel ?= "linux-toradex"
PREFERRED_PROVIDER_linux-mfgtool ?= "linux-toradex-mfgtool"

MACHINE_FIRMWARE:append:mx6 = " linux-firmware-ath6k"
MACHINE_FEATURES += " pci wifi bluetooth"
IMAGE_FSTYPES:remove = "sdcard"
IMAGE_FSTYPES = "tar.bz2"

TXBASE ?= "mb7"
```

## conf/machine/mio-2363.conf
```bitbake
#@TYPE: Machine
#@NAME: mio-2363 (intel-corei7-64)

require conf/machine/include/meta-intel.inc
require conf/machine/include/intel-corei7-64-common.inc
require conf/machine/include/intel-common-pkgarch.inc

MACHINE_FEATURES += "efi"
MACHINE_FEATURES += "intel-ucode"

MACHINE_HWCODECS ?= "${@bb.utils.contains('TUNE_FEATURES', 'mx32', '', 'intel-media-driver    intel-mediasdk', d)} intel-vaapi-driver gstreamer1.0-vaapi"

# Enable optional dpdk:
COMPATIBLE_MACHINE_pn-dpdk = "intel-corei7-64"

# Enable optional QAT items:
COMPATIBLE_MACHINE_pn-qat16 = "intel-corei7-64"
COMPATIBLE_MACHINE_pn-qat17 = "intel-corei7-64"
COMPATIBLE_MACHINE_pn-zlib-qat = "intel-corei7-64"

SYSLINUX_OPTS = "serial 0 115200"
SERIAL_CONSOLES = "115200;ttyS0 115200;ttyS1"
APPEND += "rootwait console=ttyS0,115200 console=tty0"

#WKS_FILE ?= "${@bb.utils.contains_any("EFI_PROVIDER", "systemd-boot", "systemd-bootdisk-microcode.wks.in", "grub-bootdisk-microcode.wks.in", d)}"
WKS_FILE = "image-installer.wks.in"
WKS_FILE_DEPENDS:append = " intel-microcode"

EFI_PROVIDER = "systemd-boot"
SYSTEMD_BOOT_TIMEOUT = "0"

IMAGE_FSTYPES += "wic ext4"
IMAGE_TYPEDEP_wic = "ext4"
INITRD_IMAGE_LIVE = "core-image-minimal-initramfs"
do_image_wic[depends] += "${INITRD_IMAGE_LIVE}:do_image_complete"
do_image_wic[depends] += "${IMAGE_BASENAME}:do_image_ext4"
do_rootfs[depends] += "virtual/kernel:do_deploy"

IMAGE_BOOT_FILES:append = " \
  ${KERNEL_IMAGETYPE} \
  microcode.cpio \
  ${IMGDEPLOYDIR}/${IMAGE_BASENAME}-${MACHINE}.ext4;rootfs.img \
  ${DEPLOY_DIR_IMAGE}/modules-${MACHINE}.tgz;modules.tgz \
  ${@bb.utils.contains('EFI_PROVIDER', 'grub-efi', 'grub-efi-bootx64.efi;EFI/BOOT/bootx64.efi', '', d)} \
  ${@bb.utils.contains('EFI_PROVIDER', 'grub-efi', '${IMAGE_ROOTFS}/boot/EFI/BOOT/grub.cfg;EFI/BOOT/grub.cfg', '', d)} \
  ${@bb.utils.contains('EFI_PROVIDER', 'systemd-boot', 'systemd-bootx64.efi;EFI/BOOT/bootx64.efi', '', d)} \
  ${@bb.utils.contains('EFI_PROVIDER', 'systemd-boot', '${IMAGE_ROOTFS}/boot/loader/loader.conf;loader/loader.conf ', '', d)} \
  ${@bb.utils.contains('EFI_PROVIDER', 'systemd-boot', '${IMAGE_ROOTFS}/boot/loader/entries/boot.conf;loader/entries/boot.conf', '', d)} "
```

## conf/machine/mx6ul-comm-module.conf
```bitbake
#@TYPE: Machine
#@NAME: mx6ul-comm-module
#@DESCRIPTION: EVOLOGICS Communication Module i.MX6 ULL, 512MB RAM, eMMC
#@ARTICLENUMBERS: PB-02013-410I.A0, PCL-063-20910CI.A0

require conf/machine/include/phyimx6ul.inc

SOC_FAMILY .= ":phyboard-segin-imx6ul"

# Kernel
KERNEL_DEVICETREE = "imx6ul-comm-module.dtb"

# Barebox Config
BAREBOX_BIN = "images/barebox-phytec-phycore-imx6ull-emmc-512mb.img"

WKS_FILES_mx6ul = "comm-module.wks"

MACHINE_FEATURES += "can emmc"
```

## conf/machine/sama5d2-roadrunner-evo.conf
```bitbake
#@TYPE: Machine
#@Name: ACME Roadrunner on EvoLogics baseboard
#@DESCRIPTION: Machine configuration for ACME Roadrunner on EvoLogics baseboard

AT91BOOTSTRAP_MACHINE ?= "sama5d2_roadrunner"
require conf/machine/include/sama5d2.inc

MACHINE_FEATURES = "kernel26 apm ext4 usbhost usbgadget can ppp"
KERNEL_DEVICETREE = " \
		${MACHINE}.dtb \
		overlays/${MACHINE}-tiny.dtb \
		overlays/${MACHINE}-tiny-eth.dtb \
		overlays/${MACHINE}-tiny-rs232.dtb \
		overlays/${MACHINE}-tiny-rs422.dtb \
		overlays/${MACHINE}-tiny-rs485.dtb \
		overlays/${MACHINE}-tiny-can.dtb \
        \
		overlays/${MACHINE}-r2.dtb \
		overlays/${MACHINE}-r2-eth.dtb \
		overlays/${MACHINE}-r2-rs232.dtb \
		overlays/${MACHINE}-r2-rs422.dtb \
		overlays/${MACHINE}-r2-rs485.dtb \
		overlays/${MACHINE}-r2-can.dtb \
		"
EXTRA_IMAGEDEPENDS:remove = "virtual/bootloader"
EXTRA_IMAGEDEPENDS:remove = "at91bootstrap-sam-ba"
IMAGE_BOOTLOADER = ""
#UBOOT_MACHINE ?= "sama5d2_xplained_spiflash_defconfig"
#UBOOT_ENTRYPOINT = "0x20008000"
#UBOOT_LOADADDRESS = "0x20008000"

# Needed for wic
#EXTRA_IMAGEDEPENDS += "dosfstools-native mtools-native"

# FIXME: move to distro/evo-poky.conf
# roadrunner added in 3.8.9-rc1
#PREFERRED_VERSION_at91bootstrap = "3.8+git%"

# FIXME: did't work. find out why
#CMDLINE_sama5d2-roadrunner-evomini2 = "mem=256M console=ttyS0,115200 root=/dev/mtdblock3 root=ubi0:0 rootfstype=ubifs rw"

# NOTE: in dts bootargs = 
#CMDLINE = "mem=256M console=ttyS0,115200 ubi.mtd=3 root=ubi0:0 rootfstype=ubifs rw"

#KERNEL_IMAGE_MAXSIZE ?= "2097152"

PREFERRED_VERSION_linux-at91 = "4.14%"
PREFERRED_VERSION_erlang = "21.1.0"
PREFERRED_VERSION_erlang-native = "21.1.0"
PREFERRED_VERSION_nativesdk-erlang = "21.1.0"
```

## conf/machine/sama5d2-roadrunner-evomini2.conf
```bitbake
#@TYPE: Machine
#@Name: ACME Roadrunner on EvoLogics baseboard
#@DESCRIPTION: Machine configuration for ACME Roadrunner on EvoLogics baseboard

AT91BOOTSTRAP_MACHINE ?= "sama5d2_roadrunner"
require conf/machine/include/sama5d2.inc

MACHINE_FEATURES = "kernel26 apm ext4 usbhost usbgadget can ppp"
KERNEL_DEVICETREE = " \
		${MACHINE}-eth.dtb \
		${MACHINE}-can.dtb \
		${MACHINE}-rs422.dtb \
		${MACHINE}-rs485.dtb \
		"
#IMAGE_FSTYPES += " tar.gz wic"
IMAGE_FSTYPES += " tar.xz ubi jffs2"

#TCLIBC = "musl"

#WKS_FILE = "sdimage.wks"

EXTRA_IMAGEDEPENDS_remove = "virtual/bootloader"
IMAGE_BOOTLOADER = ""
#UBOOT_MACHINE ?= "sama5d2_xplained_spiflash_defconfig"
#UBOOT_ENTRYPOINT = "0x20008000"
#UBOOT_LOADADDRESS = "0x20008000"

# Needed for wic
#EXTRA_IMAGEDEPENDS += "dosfstools-native mtools-native"

# FIXME: move to distro/evo-poky.conf
# roadrunner added in 3.8.9-rc1
#PREFERRED_VERSION_at91bootstrap = "3.8+git%"

# FIXME: did't work. find out why
#CMDLINE_sama5d2-roadrunner-evomini2 = "mem=256M console=ttyS0,115200 root=/dev/mtdblock3 root=ubi0:0 rootfstype=ubifs rw"

# NOTE: in dts bootargs = 
#CMDLINE = "mem=256M console=ttyS0,115200 ubi.mtd=3 root=ubi0:0 rootfstype=ubifs rw"

#KERNEL_IMAGE_MAXSIZE ?= "2097152"

#UBINIZE_ARGS = "-m 4KiB -p 4KiB"
UBINIZE_ARGS = "-m 1 -p 4KiB"
# -O 64"
# ubi0: volume 0 ("sama5d2-roadrunner-evomini2-rootfs") re-sized from 991 to 2982 LEBs
MKUBIFS_ARGS = "-m 1 -e 16KiB -c 2982 -F"

JFFS2_ERASEBLOCK = "0x1000"
EXTRA_IMAGECMD_jffs2 = "${JFFS2_ENDIANNESS} --eraseblock=${JFFS2_ERASEBLOCK} --no-cleanmarkers"
```

## conf/machine/tegra194-evo.conf
```bitbake
#
#@TYPE: Machine
#@NAME: Nvidia Jetson Xavier NX Evo baseboard - eMMC
#@DESCRIPTION: Nvidia Jetson Xavier NX Evologics Baseboard with QSPI+eMMC module
#

TEGRA_BOARDSKU ?= "0001"
TEGRA_BUPGEN_SPECS ?= "fab=100;boardsku=0001;boardrev= \
                       fab=200;boardsku=0001;boardrev= \
                       fab=300;boardsku=0001;boardrev= \
                       fab=301;boardsku=0001;boardrev="

IMAGE_ROOTFS_ALIGNMENT ?= "4"

require conf/machine/include/xavier-nx.inc

KERNEL_DEVICETREE = "_ddot_/_ddot_/_ddot_/_ddot_/nvidia/platform/t19x/jakku/kernel-dts/tegra194-evo.dtb"

EMMC_SIZE ?= "15758000128"

PARTITION_LAYOUT_TEMPLATE ?= "flash_${MACHINE}_custom.xml"

# Default to 7GiB rootfs part size for 16GiB units
ROOTFSPART_SIZE = "7516192768"

IMAGE_CLASSES += "image_types_tegra"

IMAGE_FSTYPES = "tar.gz tegraflash"

MACHINE_FEATURES_remove = "wifi bluetooth"

#Cuda support for gcc
GCCVERSION = "8.%"

KERNEL_ARGS:append = " loglevel=3"
KERNEL_ARGS:remove = "console=tty0"

DISTRO_FEATURES_append = " ldconfig virtualization x11 opengl"

PACKAGE_EXTRA_ARCHS_append = " jetson-xavier-nx-devkit-emmc"
```

## conf/machine/tx6q-8037-evobb.conf
```bitbake
#@TYPE: Machine
#@NAME: Ka-Ro electronics i.MX6QP TX6QP Computer-On-Module installed on EvoLogics baseboard
#@SOC: i.MX6QP
#@DESCRIPTION: Machine configuration for Ka-Ro electronics TX6DL Computer-On-Module

MACHINEOVERRIDES =. "mx6:mx6q:tx6:"

require conf/machine/include/tx6-karo-common.inc

PREFERRED_VERSION_linux-karo = "4.4.15"
KERNEL_DEVICETREE ?= "imx6-${MACHINE}.dtb"

UBOOT_MACHINE = "tx6qp-8037_config"

TXTYPE = "imx6qp-tx6"
TXNVM = "emmc"
```

## conf/machine/tx6q-8137-evobb.conf
```bitbake
#@TYPE: Machine
#@NAME: Ka-Ro electronics i.MX6QP TX6QP Computer-On-Module installed on EvoLogics baseboard
#@SOC: i.MX6QP
#@DESCRIPTION: Machine configuration for Ka-Ro electronics TX6DL Computer-On-Module

MACHINEOVERRIDES =. "mx6:mx6q:tx6:mx6-evobb:"

require conf/machine/include/tx6-karo-common.inc

KERNEL_DEVICETREE ?= "imx6-${MACHINE}.dtb"

UBOOT_MACHINE = "tx6qp-8137_config"

TXTYPE = "imx6qp-tx6"
TXNVM = "emmc"
TXBASE_append = "-lvds"
```

## conf/machine/tx6s-8035-evobb.conf
```bitbake
#@TYPE: Machine
#@NAME: Ka-Ro electronics i.MX6S TX6S Computer-On-Module installed on EvoLogics baseboard
#@SOC: i.MX6S
#@DESCRIPTION: Machine configuration for Ka-Ro electronics TX6S Computer-On-Module

MACHINEOVERRIDES =. "mx6:mx6dl:tx6:mx6-evobb:"

require conf/machine/include/tx6-karo-common.inc

KERNEL_DEVICETREE ?= "imx6-${MACHINE}.dtb"

UBOOT_CONFIG ?= "emmc"
UBOOT_CONFIG[emmc] = "tx6s-8035_config"
UBOOT_CONFIG[mfgtool] = "tx6s-8035_mfg_defconfig"

TXTYPE = "imx6s-tx6"
TXNVM = "emmc"
```

## conf/machine/tx6u-8033-evobb.conf
```bitbake
#@TYPE: Machine
#@NAME: Ka-Ro electronics i.MX6DL TX6DL Computer-On-Module installed on EvoLogics baseboard
#@SOC: i.MX6DL
#@DESCRIPTION: Machine configuration for Ka-Ro electronics TX6DL Computer-On-Module installed on EvoLogics baseboard

MACHINEOVERRIDES =. "mx6:mx6dl:tx6:"

require conf/machine/include/tx6-karo-common.inc

PREFERRED_VERSION_linux-karo = "4.4.15"
KERNEL_DEVICETREE = "imx6-${MACHINE}.dtb"

UBOOT_MACHINE = "tx6u-8033_config"

TXTYPE = "imx6dl-tx6"
TXNVM = "emmc"
```

## conf/machine/tx6u-8133-evobb.conf
```bitbake
#@TYPE: Machine
#@NAME: Ka-Ro electronics i.MX6DL TX6DL Computer-On-Module installed on EvoLogics baseboard
#@SOC: i.MX6DL
#@DESCRIPTION: Machine configuration for Ka-Ro electronics TX6DL Computer-On-Module installed on EvoLogics baseboard

MACHINEOVERRIDES =. "mx6:mx6dl:tx6:mx6-evobb:"

require conf/machine/include/tx6-karo-common.inc

KERNEL_DEVICETREE = "imx6-${MACHINE}.dtb"

UBOOT_CONFIG ?= "emmc"
UBOOT_CONFIG[emmc] = "tx6u-8133_config"
UBOOT_CONFIG[mfgtool] = "tx6u-8133_mfg_defconfig"

TXTYPE = "imx6dl-tx6"
TXNVM = "emmc"
```

## recipes-bsp/at91bootstrap/files/sama5d2-roadrunner-evo_defconfig
```kconfig
# Copyright (C) 2006 Microchip Technology Inc. and its subsidiaries
#
# SPDX-License-Identifier: MIT

CONFIG_LOAD_AND_JUMP=y
CONFIG_LOAD_SW=y
CONFIG_JUMP_TO_SW=y
CONFIG_SAMA5D2=y
CONFIG_CRYSTAL_12_000MHZ=y
# CONFIG_TWI is not set
# CONFIG_LOAD_HW_INFO is not set
CONFIG_BUS_SPEED_166MHZ=y
CONFIG_DDR_SET_BY_DEVICE=y
CONFIG_DDR_MT41K128M16_D2=y
CONFIG_DATAFLASH=y
CONFIG_SPI_FLASH=y
CONFIG_SPI_CLK=132000000
CONFIG_QSPI=y
CONFIG_QSPI_BUS=0
CONFIG_QSPI_IOSET=3
CONFIG_QSPI_4B_OPCODES=y
CONFIG_LOAD_LINUX=y
CONFIG_LINUX_IMAGE=y
CONFIG_IMG_ADDRESS="0x00020000"
CONFIG_JUMP_ADDR="0x22000000"
CONFIG_OF_LIBFDT=y
CONFIG_OF_OFFSET="0x00010000"
CONFIG_OF_ADDRESS="0x21000000"
CONFIG_MACH_TYPE="9999"
# CONFIG_DISABLE_WATCHDOG is not set
# CONFIG_ENTER_NWD is not set
CONFIG_BOARD_QUIRK_SAMA5D2_ROADRUNNER_EVO=y
CONFIG_TWI0=y
CONFIG_TWI0_IOSET=4
CONFIG_TWI1=y
CONFIG_TWI1_IOSET=2
# CONFIG_ACT8865 is not set
# CONFIG_DISABLE_ACT8865_I2C is not set
# CONFIG_SUSPEND_ACT8945A_CHARGER is not set
# CONFIG_LOAD_EEPROM is not set
# CONFIG_LED_ON_BOARD is not set
```
